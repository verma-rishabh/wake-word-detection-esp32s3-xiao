## components/hardware_driver/Kconfig.projbuild.new
```kconfig
menu "Audio Media HAL"

    choice AUDIO_BOARD
        prompt "Audio hardware board"
        default ESP32_S3_XIAO_BOARD
        help
            Select an audio board to use
    config ESP32_S3_XIAO_BOARD
        bool "ESP32-XIAO-EYE"
        depends on IDF_TARGET_ESP32S3
    endchoice
    
    endmenu
    
```
